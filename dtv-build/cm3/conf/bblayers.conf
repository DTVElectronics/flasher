## dtv-build/cm3/conf/bblayers.conf
```bitbake
# POKY_BBLAYERS_CONF_VERSION is increased each time build/conf/bblayers.conf
# changes incompatibly
POKY_BBLAYERS_CONF_VERSION = "2"

BBPATH = "${TOPDIR}"
BBFILES ?= ""

BBLAYERS ?= " \
  ${TOPDIR}/../../meta-openembedded/meta-oe \
  ${TOPDIR}/../../meta-openembedded/meta-python \
  ${TOPDIR}/../../meta-openembedded/meta-networking \
  ${TOPDIR}/../../meta-openembedded/meta-filesystems \
  ${TOPDIR}/../../meta-openembedded/meta-webserver \
  ${TOPDIR}/../../meta-clang \
  ${TOPDIR}/../../meta-rockchip \
  ${TOPDIR}/../../poky/meta \
  ${TOPDIR}/../../meta-flash \
  ${TOPDIR}/../../meta-arm/meta-arm \
  ${TOPDIR}/../../meta-arm/meta-arm-toolchain \
  ${TOPDIR}/../../poky/meta-poky \
  ${TOPDIR}/../../poky/meta-yocto-bsp \
"
```
